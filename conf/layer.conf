## conf/layer.conf
```bitbake
# We have a conf directory, add to BBPATH so the bundle bbappends can
# `require recipes-images/bundles/edgefirst-rauc-signing.inc` by layer path.
BBPATH .= ":${LAYERDIR}"

BBFILES += "${LAYERDIR}/recipes-*/*/*.bb \
            ${LAYERDIR}/recipes-*/*/*.bbappend"

BBFILE_COLLECTIONS += "edgefirst-phytec"
BBFILE_PATTERN_edgefirst-phytec = "^${LAYERDIR}/"
BBFILE_PRIORITY_edgefirst-phytec = "11"

LAYERDEPENDS_edgefirst-phytec = "ampliphy rauc meta-edgefirst"
LAYERSERIES_COMPAT_edgefirst-phytec = "walnascar wrynose"
```
